## boards/shields/Atreus62/Kconfig.defconfig
```kconfig
if SHIELD_ATREUS62

# Name must be less than 16 characters long!
config ZMK_KEYBOARD_NAME
    default "Atreus62"

endif
```

## boards/shields/Atreus62/Kconfig.shield
```kconfig
# No whitespace after the comma or in your keyboard name!
config SHIELD_ATREUS62
    def_bool $(shields_list_contains,atreus62)
```
